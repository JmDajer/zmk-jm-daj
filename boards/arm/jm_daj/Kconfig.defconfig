## boards/arm/jm_daj/Kconfig.defconfig
```kconfig
if BOARD_JM_DAJ

config ZMK_KEYBOARd_NAME
	default "jm_daj"

if USB_DEVICE_STACK

config USB_NRFX
	default y

endif # USB_DEVICE_STACK

config BT_CTLR
	default BT

endif # BOARD_JM_DAJ
```

## boards/arm/jm_daj/jm_daj_defconfig
```kconfig
CONFIG_SOC_SERIES_NRF52X=y
CONFIG_SOC_NRF52840_QIAA=y
CONFIG_BOARD_JM_DAJ=y

CONFIG_MPU_ALLOW_FLASH_WRITE=y
CONFIG_NVS=y
CONFIG_SETTINGS_NVS=y
CONFIG_FLASH=y
CONFIG_FLASH_PAGE_LAYOUT=y
CONFIG_FLASH_MAP=y

# Enable MPU
CONFIG_ARM_MPU=y

# Enable GPIO
CONFIG_GPIO=y

# Use internal RC oscillator if no external crystal
CONFIG_CLOCK_CONTROL_NRF_K32SRC_RC=y
CONFIG_CLOCK_CONTROL_NRF_K32SRC_XTAL=n
CONFIG_CLOCK_CONTROL_NRF_K32SRC_50PPM=n

# Build hex - start at 0x0 (no bootloader)
CONFIG_USE_DT_CODE_PARTITION=y
CONFIG_BUILD_OUTPUT_HEX=y
CONFIG_BUILD_OUTPUT_UF2=n

# Disable sleep for debugging
CONFIG_ZMK_SLEEP=n
CONFIG_ZMK_IDLE_SLEEP_TIMEOUT=0 

# USB Configuration
CONFIG_USB_DEVICE_STACK=y
CONFIG_USB_DEVICE_PRODUCT="JM DAJ Keyboard"
CONFIG_USB_DEVICE_VID=0x1209
CONFIG_USB_DEVICE_PID=0x0001
CONFIG_USB_DEVICE_MANUFACTURER="JM"

CONFIG_ZMK_USB=y
CONFIG_ZMK_BLE=y

# BLE Configuration
CONFIG_BT=y
CONFIG_BT_CTLR=y
CONFIG_BT_PERIPHERAL=y
CONFIG_BT_DEVICE_NAME="JM DAJ"
CONFIG_BT_DEVICE_APPEARANCE=961
CONFIG_BT_GATT_DYNAMIC_DB=y
CONFIG_BT_MAX_CONN=1
CONFIG_BT_MAX_PAIRED=1
CONFIG_BT_SETTINGS=y
CONFIG_BT_DIS=y
CONFIG_BT_BAS=y

# BLE Security and Pairing
CONFIG_BT_SMP=y
CONFIG_BT_SIGNING=y
CONFIG_BT_SMP_SC_ONLY=n
CONFIG_BT_FIXED_PASSKEY=y
CONFIG_BT_USE_DEBUG_KEYS=y

# Memory Configuration
CONFIG_HEAP_MEM_POOL_SIZE=2048
CONFIG_MAIN_STACK_SIZE=2048
CONFIG_SYSTEM_WORKQUEUE_STACK_SIZE=2048

# Debug Console via RTT only
CONFIG_CONSOLE=y
CONFIG_RTT_CONSOLE=y
CONFIG_USE_SEGGER_RTT=y
CONFIG_SEGGER_RTT_BUFFER_SIZE_UP=2048
CONFIG_LOG=y
CONFIG_LOG_DEFAULT_LEVEL=4
CONFIG_ZMK_USB_LOGGING=n
CONFIG_ZMK_LOG_LEVEL_DBG=y
CONFIG_UART_CONSOLE=n

# Power Management
CONFIG_PM=n
CONFIG_PM_DEVICE=n
```

## boards/shields/jm_daj/Kconfig.defconfig
```kconfig
if SHIELD_JM_DAJ

config ZMK_KEYBOARD_NAME
    default "jm_daj"

config BUILD_OUTPUT_HEX
    default y

endif
```

## config/boards/arm/jm_daj/Kconfig.defconfig
```kconfig
if BOARD_JM_DAJ

config BOARD
	default "jm_daj"

if USB_DEVICE_STACK

config USB_NRFX
	default y

endif # USB_DEVICE_STACK

config BT_CTLR
	default BT

endif # BOARD_JM_DAJ
```

## config/boards/arm/jm_daj/jm_daj_defconfig
```kconfig
CONFIG_SOC_SERIES_NRF52X=y
CONFIG_SOC_NRF52840_QIAA=y
CONFIG_BOARD_JM_DAJ=y

# Enable MPU
CONFIG_ARM_MPU=y

# enable uart driver
CONFIG_SERIAL=y

# enable console
CONFIG_CONSOLE=y
CONFIG_UART_CONSOLE=y

CONFIG_GPIO=y

CONFIG_USE_DT_CODE_PARTITION=y

CONFIG_BUILD_OUTPUT_UF2=y
CONFIG_BUILD_OUTPUT_HEX=y
```
